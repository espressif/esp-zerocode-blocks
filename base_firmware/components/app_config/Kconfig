## base_firmware/components/app_config/Kconfig
```kconfig
menu "ZeroCode AI Product Configuration"

    config APP_LED_GPIO
        int "Main LED GPIO number"
        default 8
        help
            GPIO number for the main LED output.

    config APP_BUTTON_GPIO
        int "Toggle button GPIO number"
        default 9
        help
            GPIO number for the toggle button input.

endmenu
```

## code_blocks/behaviors/task_watchdog/sdkconfig.defaults
```kconfig
CONFIG_ESP_TASK_WDT_INIT="y"
CONFIG_ESP_TASK_WDT_PANIC="y"
CONFIG_ESP_TASK_WDT_TIMEOUT_S="10"
CONFIG_ESP_TASK_WDT_CHECK_IDLE_TASK_CPU0="y"
CONFIG_ESP_TASK_WDT_CHECK_IDLE_TASK_CPU1="y"
```

## code_blocks/frameworks/lm/components/esp_tinylm/Kconfig
```kconfig
menu "esp_tinylm"

    config ESP_TINYLM_ENABLE_PIE
        bool "Use ESP32-S31 PIE vector kernel when available"
        default y
        help
            On ESP32-S31, run the int4 matvec on the PIE (xespv) vector unit for
            a large speedup. Has no effect on other targets, which always use the
            portable scalar path. Disable to force the scalar path everywhere
            (e.g. for A/B numerical comparison).

endmenu
```

## code_blocks/frameworks/rainmaker/sdkconfig.defaults
```kconfig
CONFIG_ESP_RMAKER_SELF_CLAIM="y"
CONFIG_ESP_RMAKER_ENABLE_CHALLENGE_RESPONSE="n"
CONFIG_ESP_RMAKER_USE_NVS="y"
CONFIG_APP_NETWORK_ASYNCHRONOUS_CONNECTION="y"
CONFIG_BT_ENABLED="y"
CONFIG_BT_NIMBLE_ENABLED="y"
```

## code_blocks/sdkconfig-fragments/c6_thread_only/sdkconfig.defaults
```kconfig
CONFIG_ESP_WIFI_ENABLED="n"
CONFIG_OPENTHREAD_ENABLED="y"
CONFIG_OPENTHREAD_BORDER_ROUTER="n"
CONFIG_MBEDTLS_CMAC_C="y"
```

## code_blocks/sdkconfig-fragments/coredump/sdkconfig.defaults
```kconfig
CONFIG_ESP_COREDUMP_ENABLE_TO_UART="y"
CONFIG_ESP_COREDUMP_MAX_TASKS_NUM=64
CONFIG_ESP_COREDUMP_STACK_SIZE=2048
CONFIG_ESP_COREDUMP_LOGS="n"
```
