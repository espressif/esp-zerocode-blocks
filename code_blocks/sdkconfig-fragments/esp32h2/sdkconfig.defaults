## code_blocks/sdkconfig-fragments/power_management/sdkconfig.defaults
```kconfig
CONFIG_PM_ENABLE="y"
CONFIG_PM_SLP_IRAM_OPT="y"
CONFIG_PM_RTOS_IDLE_OPT="y"
CONFIG_ESP_WIFI_SLP_IRAM_OPT="y"
CONFIG_FREERTOS_USE_TICKLESS_IDLE="y"
CONFIG_FREERTOS_HZ=1000
CONFIG_RINGBUF_PLACE_FUNCTIONS_INTO_FLASH="y"
CONFIG_RINGBUF_PLACE_ISR_FUNCTIONS_INTO_FLASH="y"
```

## code_blocks/sdkconfig-fragments/production/sdkconfig.defaults
```kconfig
CONFIG_BOOTLOADER_COMPRESSED_ENABLED="y"
CONFIG_BOOTLOADER_APP_ROLLBACK_ENABLE="y"
CONFIG_BOOTLOADER_APP_ANTI_ROLLBACK="y"
CONFIG_BOOTLOADER_APP_SECURE_VERSION=0
CONFIG_LOG_COLORS="n"
CONFIG_ESP_DEBUG_OCDAWARE="n"
CONFIG_NEWLIB_NANO_FORMAT="y"
```

## code_blocks/sdkconfig-fragments/secure_boot/sdkconfig.defaults
```kconfig
CONFIG_SECURE_BOOT="y"
CONFIG_SECURE_BOOT_BUILD_SIGNED_BINARIES="y"
CONFIG_USE_ESP32_ECDSA_PERIPHERAL="y"
CONFIG_SECURE_DISABLE_ROM_DL_MODE="y"
```

## code_blocks/sdkconfig-fragments/wifi_min_memory/sdkconfig.defaults
```kconfig
CONFIG_ESP_WIFI_STATIC_RX_BUFFER_NUM=3
CONFIG_ESP_WIFI_DYNAMIC_RX_BUFFER_NUM=6
CONFIG_ESP_WIFI_DYNAMIC_TX_BUFFER_NUM=16
CONFIG_ESP_WIFI_SOFTAP_SUPPORT="n"
CONFIG_ESP_WIFI_IRAM_OPT="n"
CONFIG_ESP_WIFI_RX_IRAM_OPT="n"
```
