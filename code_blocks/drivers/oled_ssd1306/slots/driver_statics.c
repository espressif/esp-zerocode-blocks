/* THE BUS IS SOMEBODY ELSE'S. Whoever owns this port created it — an earlier
 * peripherals/i2c_bus instance in a product that wires its own, or the board
 * manager on a board that owns the port — and ESP-IDF's own registry is the
 * join. So this block names a PORT, asks the driver for that port's bus, and
 * attaches ONE device to it. See CLAUDE.md → How an I2C block gets its bus. */
static i2c_master_dev_handle_t s_{{prefix_lc}}_i2c_dev = NULL;

static esp_err_t {{prefix_lc}}_i2c_attach(void)
{
    if (s_{{prefix_lc}}_i2c_dev != NULL) return ESP_OK;
    i2c_master_bus_handle_t {{prefix_lc}}_bus = NULL;
    esp_err_t {{prefix_lc}}_err = i2c_master_get_bus_handle((i2c_port_num_t){{prefix}}_OLED_PORT, &{{prefix_lc}}_bus);
    if ({{prefix_lc}}_err != ESP_OK) {
        /* Fail CLOSED, and say which port. Aborting would take a whole product
         * down for one absent sensor; staying quiet is how a device ends up
         * silent with nothing in any report saying why. */
        ESP_LOGE(TAG, "{{prefix_lc}}: no I2C bus on port %d (%s) — needs a bus provider EARLIER in the product, or a board that owns the port",
                 (int){{prefix}}_OLED_PORT, esp_err_to_name({{prefix_lc}}_err));
        return {{prefix_lc}}_err;
    }
    /* Field-by-field, not a designated-initializer list: these files compile as
     * C++, where initializer order is fixed and a nested flags struct makes the
     * positional form brittle. SCL speed is per DEVICE under this driver. */
    i2c_device_config_t {{prefix_lc}}_dev_cfg = {};
    {{prefix_lc}}_dev_cfg.dev_addr_length = I2C_ADDR_BIT_LEN_7;
    {{prefix_lc}}_dev_cfg.device_address = {{prefix}}_OLED_ADDR;
    {{prefix_lc}}_dev_cfg.scl_speed_hz = {{prefix}}_OLED_FREQ_HZ;
    {{prefix_lc}}_err = i2c_master_bus_add_device({{prefix_lc}}_bus, &{{prefix_lc}}_dev_cfg, &s_{{prefix_lc}}_i2c_dev);
    if ({{prefix_lc}}_err != ESP_OK) {
        ESP_LOGE(TAG, "{{prefix_lc}}: i2c_master_bus_add_device(0x%02x): %s",
                 (unsigned){{prefix}}_OLED_ADDR, esp_err_to_name({{prefix_lc}}_err));
        s_{{prefix_lc}}_i2c_dev = NULL;
    }
    return {{prefix_lc}}_err;
}

static uint8_t s_{{prefix_lc}}_oled_fb[1024]; /* 128x64 / 8 */

/* 6x8 ASCII font (printable subset 0x20-0x7E). 5 columns + 1 spacer. */
static const uint8_t s_{{prefix_lc}}_oled_font[][5] = {
    {0,0,0,0,0},{0,0,0x5F,0,0},{0,7,0,7,0},{0x14,0x7F,0x14,0x7F,0x14},
    {0x24,0x2A,0x7F,0x2A,0x12},{0x23,0x13,8,0x64,0x62},{0x36,0x49,0x55,0x22,0x50},
    {0,5,3,0,0},{0,0x1C,0x22,0x41,0},{0,0x41,0x22,0x1C,0},{8,0x2A,0x1C,0x2A,8},
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    {0,0,0x7F,0,0},{0,0x41,0x36,8,0},{0x10,8,8,0x10,8},
};

static void {{prefix_lc}}_oled_cmd(uint8_t c)
{
    uint8_t buf[2] = {0x00, c};
    i2c_master_transmit(s_{{prefix_lc}}_i2c_dev, buf, 2, 50);
}

static void {{prefix_lc}}_oled_flush(void)
{
    for (int p = 0; p < 8; ++p) {
        {{prefix_lc}}_oled_cmd(0xB0 + p); /* page */
        {{prefix_lc}}_oled_cmd(0x00);     /* lo col */
        {{prefix_lc}}_oled_cmd(0x10);     /* hi col */
        uint8_t pkt[129];
        pkt[0] = 0x40;
        memcpy(pkt + 1, &s_{{prefix_lc}}_oled_fb[p * 128], 128);
        i2c_master_transmit(s_{{prefix_lc}}_i2c_dev, pkt, sizeof(pkt), 50);
    }
}

void {{prefix_lc}}_oled_clear(void) { memset(s_{{prefix_lc}}_oled_fb, 0, sizeof(s_{{prefix_lc}}_oled_fb)); {{prefix_lc}}_oled_flush(); }

void {{prefix_lc}}_oled_print(int row, const char *s)
{
    if (row < 0 || row > 7 || !s) return;
    int col = 0;
    while (*s && col < 126) {
        char ch = *s++;
        if (ch < 0x20 || ch > 0x7E) ch = ' ';
        const uint8_t *g = s_{{prefix_lc}}_oled_font[ch - 0x20];
        for (int i = 0; i < 5 && col < 127; ++i) s_{{prefix_lc}}_oled_fb[row * 128 + col++] = g[i];
        if (col < 127) s_{{prefix_lc}}_oled_fb[row * 128 + col++] = 0;
    }
    {{prefix_lc}}_oled_flush();
}
